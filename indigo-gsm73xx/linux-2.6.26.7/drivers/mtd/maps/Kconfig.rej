## indigo-gsm73xx/linux-2.6.26.7/drivers/mtd/maps/Kconfig.rej
```kconfig
***************
*** 588,594 ****
  
  config MTD_GSM73XX_LOADER
  	tristate "GSM73XX board loader flash map"
- 	depends on MTD_CFI && MPC85xx_DS
  	help
  	   This enable access routines for the flash chips on gsm73xx
  	   boards.Ifyou have one of these boards and would like to use
--- 588,594 ----
  
  config MTD_GSM73XX_LOADER
  	tristate "GSM73XX board loader flash map"
+ 	depends on MTD_CFI && GSM73XX
  	help
  	   This enable access routines for the flash chips on gsm73xx
  	   boards.Ifyou have one of these boards and would like to use
```
